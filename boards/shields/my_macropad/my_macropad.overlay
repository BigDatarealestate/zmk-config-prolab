#include <dt-bindings/zmk/matrix_transform.h>

/ {
    chosen {
        zmk,kscan = &kscan0;
        // 👇 이 줄을 기존 chosen 블록 안에 추가합니다.
        zmk,battery = &vbatt; 
    };

    kscan0: kscan_0 {
        compatible = "zmk,kscan-gpio-direct";
        wakeup-source;
        input-gpios
            = <&gpio0 20 (GPIO_PULL_UP | GPIO_ACTIVE_LOW)>
            , <&gpio1 0 (GPIO_PULL_UP | GPIO_ACTIVE_LOW)>
            , <&gpio1 6 (GPIO_PULL_UP | GPIO_ACTIVE_LOW)>
            , <&gpio0 29 (GPIO_PULL_UP | GPIO_ACTIVE_LOW)>
            , <&gpio1 13 (GPIO_PULL_UP | GPIO_ACTIVE_LOW)>
            , <&gpio0 9 (GPIO_PULL_UP | GPIO_ACTIVE_LOW)>
            , <&gpio0 8  (GPIO_PULL_UP | GPIO_ACTIVE_LOW)>
            , <&gpio0 6  (GPIO_PULL_UP | GPIO_ACTIVE_LOW)>
            , <&gpio0 31  (GPIO_PULL_UP | GPIO_ACTIVE_LOW)>
            ;
    };

    // 👇 kscan0 블록 아래에 이 부분을 통째로 추가합니다.
    vbatt: vbatt {
        compatible = "zmk,battery-voltage-divider";
        label = "BATTERY";
        io-channels = <&adc 0>;
        output-ohms = <2000000>;
        full-ohms = <(2000000 + 820000)>;
    };
};
