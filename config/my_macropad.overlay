#include <dt-bindings/zmk/matrix_transform.h>

/ {
    zmk,kscan {
        compatible = "zmk,kscan-gpio-direct";
        label = "DIRECT_PINS";
        input-gpios
            = <&pro_micro P0_17 (GPIO_ACTIVE_LOW | GPIO_PULL_UP)>
            , <&pro_micro P0_20 (GPIO_ACTIVE_LOW | GPIO_PULL_UP)>
            , <&pro_micro P0_22 (GPIO_ACTIVE_LOW | GPIO_PULL_UP)>
            , <&pro_micro P0_24 (GPIO_ACTIVE_LOW | GPIO_PULL_UP)>
            , <&pro_micro P1_00 (GPIO_ACTIVE_LOW | GPIO_PULL_UP)>
            , <&pro_micro P1_02 (GPIO_ACTIVE_LOW | GPIO_PULL_UP)>
            ;
    };
};
